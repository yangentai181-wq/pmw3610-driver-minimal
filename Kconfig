## Kconfig
```kconfig
# Sensor data simulator
#
# Copyright (c) 2019 Nordic Semiconductor
#
# SPDX-License-Identifier: LicenseRef-Nordic-5-Clause
#

menuconfig PMW3610
    bool "PMW3610 mouse optical sensor"
  select SPI
    help
      Enable PMW3610 mouse optical sensor.

if PMW3610

config PMW3610_SMART_ALGORITHM
  bool "Enable an algorithm of PMW3610 to enhance surface coverage"
  default y
  help
    Enable the integration of the smart algorithm as the datasheet implementation.
    The algorithm is used to extend the tracking acrocss a wider range of surfaces
    such as graniles and tiles.

config PMW3610_CPI
    int "PMW3610 normal CPI boot default"
    default 800
    range 200 3200
    help
      Initial normal CPI for the runtime trackball profile. The profile can
      be updated at runtime; values must use a 200 CPI step.

config PMW3610_CPI_DIVIDOR
    int "PMW3610's default CPI dividor"
    default 1
    range 1 100
    help
      Default CPI dividor value.

config PMW3610_SNIPE_CPI
    int "PMW3610 precision CPI boot default"
    default 200
    range 200 3200
    help
      Initial precision CPI for the runtime trackball profile. The profile
      can be updated at runtime; values must use a 200 CPI step.

config PMW3610_SNIPE_CPI_DIVIDOR
    int "PMW3610's CPI dividor in snipe mode"
    default 1
    range 1 100
    help
      Snipe CPI dividor value.

config PMW3610_SCROLL_TICK
    int "PMW3610's required ticks to produce a scroll report"
    default 20
    help
      Scroll tick value.

# X/Y軸のスケーリング設定を追加（PMW3610_INVERT_Yの後あたり）
config PMW3610_X_SCALE
  int "X axis scaling factor (percentage)"
  default 100
  range 10 500
  help
    Scaling factor for X axis movement. 100 = 100% (no scaling),
    50 = 50% (half speed), 200 = 200% (double speed)

config PMW3610_Y_SCALE
  int "Y axis scaling factor (percentage)"
  default 100
  range 10 500
  help
    Scaling factor for Y axis movement. 100 = 100% (no scaling),
    50 = 50% (half speed), 200 = 200% (double speed)

choice
    prompt "Select PMW3610's polling rate"
    default PMW3610_POLLING_RATE_250

config PMW3610_POLLING_RATE_250
    bool "250 Hz"

config PMW3610_POLLING_RATE_125
    bool "125 Hz"

config PMW3610_POLLING_RATE_125_SW
    bool "125 Hz with software implementation"

endchoice

config PMW3610_FORCE_AWAKE
    bool "PMW3610 forced awake mode"
    help
      This setting forces the sensor to always be in the RUN state.

config PMW3610_RUN_DOWNSHIFT_TIME_MS
    int "PMW3610's default RUN mode downshift time"
    default 128
    range 13 3264
    help
      Default RUN mode downshift down time in milliseconds.
      Time after which sensor goes from RUN to REST1 mode.

config PMW3610_REST1_SAMPLE_TIME_MS
    int "PMW3610's sample time in REST1 stage"
    default 40
    range 10 2550
    help
      Default REST1 mode sample period in millisecond

config PMW3610_REST1_DOWNSHIFT_TIME_MS
    int "PMW3610's default REST1 mode downshift time"
    default 9600
    help
      Default REST1 mode downshift down time in milliseconds.
      Time after which sensor goes from REST1 to REST2 mode.

config PMW3610_REST2_SAMPLE_TIME_MS
    int "PMW3610's sample time in REST2 stage"
    default 0
    range 0 2550
    help
      Default REST2 mode sample period in millisecond.
      Minimum value is 10.
      No optimal value provided by datasheet.

config PMW3610_REST2_DOWNSHIFT_TIME_MS
    int "PMW3610's default REST2 mode downshift time"
    default 0
    help
      Default REST2 mode downshift down time in milliseconds.
      Time after which sensor goes from REST2 to REST3 mode.
      No optimal value provided by datasheet.

config PMW3610_REST3_SAMPLE_TIME_MS
    int "PMW3610's sample time in REST3 stage"
    default 0
    range 0 2550
    help
      Default REST2 mode sample period in millisecond.
      Minimum value is 10.
      No optimal value provided by datasheet.

choice
    prompt "Select PMW3610 sensor orientation"
    default PMW3610_ORIENTATION_0

config PMW3610_ORIENTATION_0
    bool "PMW3610 not rotated"

config PMW3610_ORIENTATION_90
    bool "PMW3610 rotated 90 deg clockwise"

config PMW3610_ORIENTATION_180
    bool "PMW3610 rotated 180 deg clockwise"

config PMW3610_ORIENTATION_270
    bool "PMW3610 rotated 270 deg clockwise"

endchoice

config PMW3610_INVERT_X
  bool "Invert the X axis of PMW3610 sensor"

config PMW3610_INVERT_Y
  bool "Invert the Y axis of PMW3610 sensor"

config PMW3610_INVERT_SCROLL_X
  bool "Invert the X axis of the scroll"
  default PMW3610_INVERT_X

config PMW3610_INVERT_SCROLL_Y
  bool "Invert the Y axis of the scroll"
  default PMW3610_INVERT_Y

config PMW3610_AUTOMOUSE_TIMEOUT_MS
  int "Amount of milliseconds the mouse layer will be active after using the trackball"
  default 400

config PMW3610_ADJUSTABLE_MOUSESPEED
  bool "Enable Adujutable mouse speed"
  default n

config PMW3610_MOVEMENT_THRESHOLD
    int "Movement threshold for automatic mouse layer activation"
    default 5
    help
        The threshold for trackball movement that triggers the automatic mouse layer.
        A higher value means more movement is required to activate the mouse layer.
        This helps prevent accidental activation during typing.

config PMW3610_DEADZONE
    int "Hard cutoff deadzone floor (0=disabled)"
    default 4
    range 0 10
    help
      Hard floor threshold. Frames with max(|raw_x|, |raw_y|) below
      this value are always suppressed as sensor noise.

config PMW3610_DEADZONE_CLEAR
    int "Active movement threshold"
    default 5
    range 2 15
    depends on PMW3610_DEADZONE > 0
    help
      Frames at or above this value are considered intentional movement
      and refresh the grace timer. Between DEADZONE and DEADZONE_CLEAR
      is the grace zone where frames pass only during active movement.

config PMW3610_DEADZONE_TIMEOUT_MS
    int "Grace period duration in milliseconds"
    default 100
    range 20 500
    depends on PMW3610_DEADZONE > 0
    help
      After the last frame above DEADZONE_CLEAR, frames in the grace
      zone are allowed for this duration. After timeout, they are
      suppressed as idle noise.

config PMW3610_DEADZONE_CONSEC_FRAMES
    int "Consecutive frames at CLEAR threshold to activate grace"
    default 2
    range 1 6
    depends on PMW3610_DEADZONE > 0
    help
      Number of consecutive frames with max_raw >= DEADZONE_CLEAR
      required before activating grace for the first time.
      After first activation, a single frame refreshes the timer.

config PMW3610_DEADZONE_ZONE_A_CONSEC
    int "Consecutive Zone A frames to deactivate grace"
    default 3
    range 1 6
    depends on PMW3610_DEADZONE > 0
    help
      Number of consecutive frames below DEADZONE required before
      deactivating grace and resetting state. Prevents isolated
      low frames during slow movement from killing active tracking.

config PMW3610_DEADZONE_REMAINDER_CAP_X10
    int "Max remainder accumulation during suppression (x10)"
    default 10
    range 0 20
    depends on PMW3610_DEADZONE > 0
    help
      Cap for move_remainder accumulation during Zone B suppression,
      multiplied by 10. 10 = 1.0 pixel max. 0 = disable accumulation
      and zero remainder on suppression (legacy behavior).

config PMW3610_AXIS_LOCK_RATIO
    int "Dominant axis lock ratio (0=disabled)"
    default 3
    range 0 10
    help
      When the dominant axis movement is this many times larger than
      the minor axis, suppress the minor axis to eliminate wavy trajectories.
      For example, ratio=3 means if X is 3x larger than Y, Y is zeroed.
      Set to 0 to disable. Recommended: 3 for typical use.

choice PMW3610_SMOOTHING_FILTER
    prompt "Smoothing filter for trackball movement"
    default PMW3610_FILTER_NONE

config PMW3610_FILTER_NONE
    bool "No smoothing filter"

config PMW3610_FILTER_EMA
    bool "EMA (Exponential Moving Average)"
    help
      Fixed-alpha EMA filter with direction reversal reset.

config PMW3610_FILTER_1EURO
    bool "1-Euro Filter (speed-adaptive)"
    help
      Adaptive low-pass filter. Heavy smoothing at low speed,
      light smoothing at high speed. Requires FPU.

endchoice

config PMW3610_EMA_ALPHA
    int "EMA alpha (current value weight, 1-99)"
    default 70
    range 1 99
    depends on PMW3610_FILTER_EMA

config PMW3610_1EURO_MIN_CUTOFF_X100
    int "1-Euro min cutoff frequency x100 (Hz)"
    default 150
    range 10 1000
    depends on PMW3610_FILTER_1EURO
    help
      Minimum cutoff frequency (Hz, x100). 150 = 1.50 Hz.
      Lower = more smoothing at low speed. Tune: decrease until jitter gone.

config PMW3610_1EURO_BETA_X1000
    int "1-Euro beta (speed coefficient) x1000"
    default 50
    range 0 500
    depends on PMW3610_FILTER_1EURO
    help
      Speed sensitivity. 50 = 0.050. Higher = faster response to fast movement.
      Tune: increase until lag at high speed is acceptable.

config PMW3610_1EURO_D_CUTOFF_X100
    int "1-Euro derivative cutoff frequency x100 (Hz)"
    default 100
    range 10 1000
    depends on PMW3610_FILTER_1EURO
    help
      Cutoff for speed estimator. 100 = 1.00 Hz. Usually keep at default.

config PMW3610_DATA_LOGGER
    bool "Enable in-memory ring buffer data logger"
    default n
    help
      Capture per-sample sensor data (raw delta, SQUAL, shutter,
      filter state, timestamps) into a RAM ring buffer for offline
      analysis. Used to diagnose floaty cursor behavior. Drains
      samples from oldest to newest; freeze the buffer with the
      &dlog_freeze behavior, then dump via &dlog_dump.

config PMW3610_DATA_LOGGER_BUFFER_SAMPLES
    int "Ring buffer capacity in samples"
    default 1250
    range 250 5000
    depends on PMW3610_DATA_LOGGER
    help
      Number of samples retained in the ring buffer. At 250Hz
      polling, 1250 samples = 5 seconds of history. Each entry
      is ~56 bytes, so 1250 samples uses ~70KB of RAM.

config PMW3610_DATA_LOGGER_AUTO_FREEZE
    bool "Auto-freeze when sustained low-velocity is detected"
    default n
    depends on PMW3610_DATA_LOGGER
    help
      Automatically freeze the ring buffer when the cursor has
      been near-stationary for a configurable period. Useful for
      catching the floaty moment without manual intervention.

config PMW3610_DATA_LOGGER_AUTO_FREEZE_MS
    int "Auto-freeze trigger duration (ms)"
    default 2000
    range 100 10000
    depends on PMW3610_DATA_LOGGER_AUTO_FREEZE

config PMW3610_DATA_LOGGER_ANOMALY_FREEZE
    bool "Auto-freeze on anomalous raw delta spike"
    default y
    depends on PMW3610_DATA_LOGGER
    help
      Automatically freeze the ring buffer when a single raw delta
      exceeds the anomaly threshold. Captures cursor jump events
      for post-mortem analysis.

config PMW3610_DATA_LOGGER_ANOMALY_THRESHOLD
    int "Anomaly threshold for raw delta (absolute)"
    default 200
    range 50 2047
    depends on PMW3610_DATA_LOGGER_ANOMALY_FREEZE
    help
      At CPI=3200 / 250Hz, normal fast flick produces raw 50-150.
      Values above 200 indicate a likely cursor jump event.

config PMW3610_DATA_LOGGER_BLE
    bool "Expose data logger over a custom BLE GATT service"
    default y
    depends on PMW3610_DATA_LOGGER && BT
    help
      Adds a custom GATT service (random 128-bit UUID) with a
      "request" characteristic (host writes 0x01 to start dump)
      and a "data" characteristic (notifies header + entries +
      footer). Used by the host-side Python logger to retrieve
      the ring buffer over the existing BLE link.

config PMW3610_DELTA_CLAMP
    bool "Clamp raw delta to prevent cursor teleportation"
    default y
    help
      Clamp each axis of the raw sensor delta to +-PMW3610_DELTA_CLAMP_MAX
      before scaling. Prevents cursor jumps caused by motion accumulation
      during polling gaps.

config PMW3610_DELTA_CLAMP_MAX
    int "Maximum allowed raw delta per axis"
    default 127
    range 50 2047
    depends on PMW3610_DELTA_CLAMP
    help
      Raw delta values exceeding this threshold on either axis are clamped.
      At CPI=3200 and 250Hz polling, 127 corresponds to approximately
      250 mm/s ball movement.

module = PMW3610
module-str = PMW3610
source "${ZEPHYR_BASE}/subsys/logging/Kconfig.template.log_config"

endif #PMW3610
```

## tests/studio_trackball_settings/testcase.yaml
```yaml
tests:
  studio_trackball_settings.unit:
    platform_allow:
      - native_posix_64
    tags:
      - trackball_settings
      - studio
```

## tests/trackball_profile/testcase.yaml
```yaml
tests:
  trackball_profile.unit:
    platform_allow:
      - native_posix_64
    tags:
      - trackball_profile
```
